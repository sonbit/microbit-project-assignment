## CMakeLists.txt
```
cmake_minimum_required(VERSION 3.20.0)
find_package(Zephyr REQUIRED HINTS $ENV{ZEPHYR_BASE})

project(microbit-project)

target_sources(app PRIVATE src/main.c src/drivers/button.c src/drivers/led.c src/drivers/speaker.c src/timer.c)
```

## prj.conf
```kconfig
CONFIG_DISPLAY=y
CONFIG_GPIO=y
CONFIG_NRFX_TIMER0=y
CONFIG_NRFX_TIMER1=y
CONFIG_PWM=y
CONFIG_TIMESLICING=y
CONFIG_TIMESLICE_SIZE=10
CONFIG_TIMESLICE_PRIORITY=0
```

## bbc_microbit_v2.overlay
```dts
// To get started, press Ctrl+Space to bring up the completion menu and view the available nodes.

// You can also use the buttons in the sidebar to perform actions on nodes.
// Actions currently available include:

// * Enabling / disabling the node
// * Adding the bus to a bus
// * Removing the node
// * Connecting ADC channels

// For more help, browse thfe DeviceTree documentation at https://docs.zephyrproject.org/latest/guides/dts/index.html
// You can also visit the nRF DeviceTree extension documentation at https://nrfconnect.github.io/vscode-nrf-connect/devicetree/nrfdevicetree.html
/ {
	zephyr,user {
		/* period cell corresponds to initial period */
		pwms = <&sw_pwm 0 PWM_USEC(1500) PWM_POLARITY_NORMAL>;
	};
};

//SPEAKER
&sw_pwm {
    status = "okay";
    channel-gpios = <&gpio0 0 GPIO_ACTIVE_HIGH>;
};
```

## src/main.c
```c
#include <zephyr/kernel.h>
#include <zephyr/sys/printk.h>

#include "drivers/button.h"
#include "drivers/led.h"
#include "drivers/speaker.h"
#include "timer.h"

#define STACKSIZE 1024
#define BUTTON_TASK_PRIORITY -1
#define DISPLAY_TASK_PRIORITY 2
#define METRONOME_TASK_PRIORITY 1

#define SOUND_DURATION 25
#define BTN_TASK_DELAY K_MSEC(150)
#define TASK_DELAY 200

K_SEM_DEFINE(btn_A_sem, 0, 1);
K_SEM_DEFINE(btn_B_sem, 0, 1);
K_SEM_DEFINE(disp_sem, 0, 1);
K_SEM_DEFINE(met_sem, 0, 1);

int counter = 500;

void btn_A_pressed(void)
{
    counter += 10;
    k_sem_give(&btn_A_sem);
}

void btn_B_pressed(void)
{
    counter -= 10;
    k_sem_give(&btn_B_sem);
}

void timer_interrupt()
{
    printk("Timer Interrupt\n");
    k_sem_give(&disp_sem);
    k_sem_give(&met_sem);
}

void button_A_task(void)
{
    while (1)
    {
        k_sem_take(&btn_A_sem, K_FOREVER);
        speaker_play_high_note(SOUND_DURATION);
        k_sleep(BTN_TASK_DELAY);
    }
}

void button_B_task(void)
{
    while (1)
    {
        k_sem_take(&btn_B_sem, K_FOREVER);
        speaker_play_low_note(SOUND_DURATION);
        k_sleep(BTN_TASK_DELAY);
    }
}

void display_task(void)
{
    // Adding semaphore take to while loop causes issues
    // But now the timer only starts but does not ensure tempo
    k_sem_take(&disp_sem, K_FOREVER);

    while (1)
    {
        printk("DISPLAY TASK\n");
        led_display(counter, counter >> 1, counter >> 2, counter >> 3, counter >> 4);
        k_sleep(K_MSEC(TASK_DELAY * 0.25));
        led_display(0, 0, 0, 0, 0);
        k_sleep(K_MSEC(TASK_DELAY * 0.75));
    }
}

void metronome_task(void)
{
    // Adding semaphore take to while loop causes issues
    // But now the timer only starts but does not ensure tempo
    k_sem_take(&met_sem, K_FOREVER);

    while (1)
    {
        printk("METRONOME TASK\n");
        speaker_play_default_note(SOUND_DURATION);
        k_sleep(K_MSEC(TASK_DELAY - SOUND_DURATION));
    }
}

K_THREAD_DEFINE(thread0_id, STACKSIZE, button_A_task, NULL, NULL, NULL, BUTTON_TASK_PRIORITY, 0, 0);
K_THREAD_DEFINE(thread1_id, STACKSIZE, button_B_task, NULL, NULL, NULL, BUTTON_TASK_PRIORITY, 0, 0);
K_THREAD_DEFINE(thread2_id, STACKSIZE, display_task, NULL, NULL, NULL, DISPLAY_TASK_PRIORITY, 0, 0);
K_THREAD_DEFINE(thread3_id, STACKSIZE, metronome_task, NULL, NULL, NULL, METRONOME_TASK_PRIORITY, 0, 0);

int main(void)
{
    printk("Starting Application\n");

    if (button_setup(btn_A_pressed, btn_B_pressed) < 0)
    {
        printk("Error when setting up buttons\n");
        return -1;
    }

    if (led_setup() < 0)
    {
        printk("Error when setting up leds\n");
        return -1;
    }

    timer_setup(timer_interrupt);

    printk("Setup Completed Successfully\n");

    while (1)
    {
        k_sleep(K_MSEC(100));
    }
}
```

## src/timer.c
```c
#include <nrfx_timer.h>

#include "timer.h"

// Most of the timer code is derived from https://github.com/aiunderstand/Real-TimeOS-with-Microbit-nRF52833

#define TIMER_INST_IDX 1
#define TIME_TO_WAIT_MS 500UL

static timer_callback_t timer_callback = NULL;

static void timer_handler(nrf_timer_event_t event_type, void *p_context)
{
    if (event_type == NRF_TIMER_EVENT_COMPARE0)
    {
        if (timer_callback != NULL)
            timer_callback();
    }
}

void timer_setup(timer_callback_t tmr_callback)
{
#if defined(__ZEPHYR__)
    IRQ_CONNECT(NRFX_IRQ_NUMBER_GET(NRF_TIMER_INST_GET(TIMER_INST_IDX)), IRQ_PRIO_LOWEST,
                NRFX_TIMER_INST_HANDLER_GET(TIMER_INST_IDX), 0, 0);
#endif

    nrfx_timer_t timer_inst = NRFX_TIMER_INSTANCE(TIMER_INST_IDX);
    uint32_t base_frequency = NRF_TIMER_BASE_FREQUENCY_GET(timer_inst.p_reg);
    nrfx_timer_config_t config = NRFX_TIMER_DEFAULT_CONFIG(base_frequency);
    config.bit_width = NRF_TIMER_BIT_WIDTH_32;
    config.p_context = "A Context";

    timer_callback = tmr_callback;
    nrfx_err_t status = nrfx_timer_init(&timer_inst, &config, timer_handler);
    NRFX_ASSERT(status == NRFX_SUCCESS);

    nrfx_timer_clear(&timer_inst);
    uint32_t desired_ticks = nrfx_timer_ms_to_ticks(&timer_inst, TIME_TO_WAIT_MS);
    nrfx_timer_extended_compare(&timer_inst, NRF_TIMER_CC_CHANNEL0, desired_ticks, NRF_TIMER_SHORT_COMPARE0_CLEAR_MASK, true);
    nrfx_timer_enable(&timer_inst);
}
```

## src/timer.h
```c
#pragma once

typedef void (*timer_callback_t)(void);

void timer_setup(timer_callback_t callback);
```
